## board-test/firmware/sdkconfig.defaults
```kconfig
CONFIG_IDF_TARGET="esp32s3"
CONFIG_ESPTOOLPY_FLASHSIZE_8MB=y
CONFIG_SPIRAM=y
CONFIG_SPIRAM_MODE_OCT=y
CONFIG_SPIRAM_SPEED_80M=y
CONFIG_SPIRAM_IGNORE_NOTFOUND=y
CONFIG_ESP_CONSOLE_NONE=y
CONFIG_ESP_CONSOLE_SECONDARY_NONE=y
CONFIG_ESP_MAIN_TASK_STACK_SIZE=8192
CONFIG_LOG_DEFAULT_LEVEL_WARN=y
CONFIG_FATFS_LFN_HEAP=y

# 処理・転送の設定
CONFIG_ESP_DEFAULT_CPU_FREQ_MHZ_240=y
CONFIG_COMPILER_OPTIMIZATION_SIZE=y
CONFIG_LWIP_TCP_SND_BUF_DEFAULT=16384
CONFIG_LWIP_TCP_WND_DEFAULT=16384
CONFIG_PARTITION_TABLE_CUSTOM=y
CONFIG_PARTITION_TABLE_CUSTOM_FILENAME="partitions.csv"
# -O2にしたカメラドライバは2KBだとcam_taskでスタックがあふれる
CONFIG_CAMERA_TASK_STACK_SIZE=4096
# index 1は縞除去の通知用（ドライバはindex 0）
CONFIG_FREERTOS_TASK_NOTIFICATION_ARRAY_ENTRIES=2
# JPEGの受信バッファ。自動(幅x高さ/5=UXGAで384KB)だと細かい景色で品質12のJPEGが入らず、
# ドライバがフレームを全部捨てて撮影・準備がタイムアウトする（2026-10-21、品質24なら約290KBで通るのを確認）
CONFIG_CAMERA_JPEG_MODE_FRAME_SIZE_CUSTOM=y
CONFIG_CAMERA_JPEG_MODE_FRAME_SIZE=786432
```
